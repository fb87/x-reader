## Kconfig
```kconfig
mainmenu "Reader configuration"

menu "Plugins"
source "build/generated/plugins.Kconfig"
endmenu
```

## main/Kconfig.projbuild
```kconfig
menu "X-Reader services"

config XREADER_WIFI_SSID
    string "Default Wi-Fi SSID"
    default ""
    help
        Optional bootstrap Wi-Fi network. Runtime NVS configuration overrides this value.

config XREADER_WIFI_PASSWORD
    string "Default Wi-Fi password"
    default ""
    help
        Password for the bootstrap Wi-Fi network.

config XREADER_OTA_MANIFEST_URL
    string "OTA manifest URL"
    default ""
    help
        JSON manifest URL. Expected fields: {"version":"...","url":"..."}.

config XREADER_SYNC_SERVER
    string "Book sync server"
    default ""
    help
        Base URL for the X-Reader sync API. Reading progress is POSTed to /v1/progress.

endmenu
```

## sdkconfig.defaults
```kconfig
CONFIG_COMPILER_CXX_EXCEPTIONS=n
CONFIG_COMPILER_CXX_RTTI=n
CONFIG_COMPILER_OPTIMIZATION_PERF=y
CONFIG_COMPILER_OPTIMIZATION_ASSERTIONS_DISABLE=y
CONFIG_ESPTOOLPY_FLASHSIZE_16MB=y
CONFIG_SPIRAM=y
CONFIG_SPIRAM_USE_CAPS_ALLOC=n
CONFIG_SPIRAM_USE_MALLOC=y
CONFIG_SPIRAM_MALLOC_ALWAYSINTERNAL=16384
CONFIG_SPIRAM_MALLOC_RESERVE_INTERNAL=32768
CONFIG_ESP_MAIN_TASK_STACK_SIZE=65536
CONFIG_PARTITION_TABLE_SINGLE_APP_LARGE=y
CONFIG_ESP_WIFI_IRAM_OPT=n
CONFIG_ESP_WIFI_RX_IRAM_OPT=n
CONFIG_ESP_SYSTEM_IN_IRAM=n
CONFIG_FREERTOS_IN_IRAM=n
CONFIG_LOG_IN_IRAM=n
CONFIG_ESP_TASK_WDT_EN=n
CONFIG_BOOTLOADER_APP_ROLLBACK_ENABLE=y
CONFIG_FATFS_LFN_HEAP=y
CONFIG_FATFS_MAX_LFN=255
CONFIG_FATFS_API_ENCODING_UTF_8=y
CONFIG_FATFS_CODEPAGE_437=y
CONFIG_PARTITION_TABLE_CUSTOM=y
CONFIG_PARTITION_TABLE_CUSTOM_FILENAME="partitions.csv"
CONFIG_PARTITION_TABLE_FILENAME="partitions.csv"
```
